## CMakeLists.txt
```
# Copyright (c) 2026 Bayrem Gharsellaoui
# SPDX-License-Identifier: Apache-2.0

if(CONFIG_SERVZ)
  zephyr_library_named(servz)

  zephyr_library_sources(
    src/service.cpp
    src/event_manager.cpp
  )

  zephyr_include_directories(
    include
  )

  zephyr_iterable_section(
    NAME service_registration
    GROUP RODATA_REGION
  )

  zephyr_linker_sources(
    SECTIONS
    ${CMAKE_CURRENT_LIST_DIR}/sections-rom.ld
  )
endif()
```

## Kconfig
```
# Copyright (c) 2026 Bayrem Gharsellaoui
# SPDX-License-Identifier: Apache-2.0

menuconfig SERVZ
	bool "servz support"
	depends on CPP
	depends on STD_CPP17
	help
		Enable C++ support.

if SERVZ

module = SERVZ
module-str = servz
source "subsys/logging/Kconfig.template.log_config"

endif # SERVZ
```

## west.yml
```
# Copyright (c) 2026 Bayrem Gharsellaoui
# SPDX-License-Identifier: Apache-2.0

manifest:
  version: "1.2"

  defaults:
    remote: zephyrproject

  remotes:
    - name: zephyrproject
      url-base: https://github.com/zephyrproject-rtos

  projects:
    - name: zephyr
      repo-path: zephyr
      revision: v4.4.2
      path: zephyr
      west-commands: scripts/west-commands.yml

  self:
    path: servz
```

## prj.conf
```kconfig
# Copyright (c) 2026 Bayrem Gharsellaoui
# SPDX-License-Identifier: Apache-2.0

# Logging
CONFIG_LOG=y
CONFIG_LOG_INFO_COLOR_GREEN=y
CONFIG_LOG_DBG_COLOR_BLUE=y

# Shell
CONFIG_SHELL=y
CONFIG_KERNEL_SHELL=y
CONFIG_REBOOT=y
```

## boards/native_sim.conf
```kconfig
# Shell/logging on stdin/stdout
CONFIG_UART_NATIVE_PTY_0_ON_STDINOUT=y
CONFIG_SHELL_LOG_BACKEND=n
CONFIG_LOG_RUNTIME_DEFAULT_LEVEL=4
```

## src/main.cpp
```c
/*
 * Copyright (c) 2026 Bayrem Gharsellaoui
 * SPDX-License-Identifier: Apache-2.0
 */

#include <zephyr/kernel.h>
#include <zephyr/logging/log.h>
LOG_MODULE_REGISTER(app, LOG_LEVEL_INF);

#include "service.hpp"

int main()
{
	LOG_INF("Registered services:");

	servz::Service::for_each(
		[](servz::Service &service) { LOG_INF("- %s", service.get_name()); });

	while (true) {
		k_msleep(1000);
	}

	return 0;
}
```

## include/app_event.hpp
```c
#pragma once

#include "event.hpp"

enum class Event : MyProject::EventId {
	ServiceAStarted,

	Count,
};

static_assert(static_cast<MyProject::EventId>(Event::Count) <= 32);
```

## include/event.hpp
```c
/*
 * Copyright (c) 2026 Bayrem Gharsellaoui
 * SPDX-License-Identifier: Apache-2.0
 */

#pragma once

#include <stdint.h>

namespace servz
{

using EventId = uint8_t;

class EventMask
{
public:
	constexpr EventMask() = default;

	template <typename... Events> static constexpr EventMask of(Events... events)
	{
		return EventMask{(0U | ... | bit(events))};
	}

	[[nodiscard]]
	constexpr bool contains(EventId event) const
	{
		return (m_bits & (1UL << event)) != 0U;
	}

private:
	explicit constexpr EventMask(uint32_t bits) : m_bits(bits)
	{
	}

	template <typename Event> static constexpr uint32_t bit(Event event)
	{
		return 1UL << static_cast<EventId>(event);
	}

	uint32_t m_bits{0U};
};

} // namespace servz
```

## include/event_manager.hpp
```c
#pragma once

#include "event.hpp"

namespace MyProject
{

class EventManager
{
public:
	EventManager() = delete;

	/**
	 * @brief Publish an event to all subscribed services.
	 *
	 * @param event Event to publish.
	 *
	 * @return true if the event was delivered to every subscribed service, otherwise false.
	 */
	static bool publish(EventId event);
};

} // namespace MyProject
```

## include/service.hpp
```c
#pragma once

#include "event.hpp"

#include <zephyr/kernel.h>
#include <zephyr/sys/iterable_sections.h>

namespace MyProject
{

class Service
{
      public:
	Service(const Service &) = delete;
	Service &operator=(const Service &) = delete;

	/**
	 * @brief Get the service name.
	 *
	 * @return Service name.
	 */
	[[nodiscard]]
	const char *get_name() const;

	/**
	 * @brief Check whether the service subscribes to an event.
	 *
	 * @param event Event identifier.
	 *
	 * @return true if the service subscribes to the event.
	 */
	[[nodiscard]]
	bool subscribes_to(EventId event) const;

	/**
	 * @brief Post an event to the service.
	 *
	 * @param event Event identifier.
	 *
	 * @return 0 on success, otherwise a negative error code.
	 */
	int post_event(EventId event);

	/**
	 * @brief Invoke a callable for each registered service.
	 *
	 * @tparam Callable Callable type accepting a Service reference.
	 * @param callable Callable to invoke for each registered service.
	 */
	template <typename Callable>
	static void for_each(Callable &&callable);

	/**
	 * @brief Zephyr thread entry point.
	 *
	 * @param p1 Pointer to the service instance.
	 * @param p2 Unused.
	 * @param p3 Unused.
	 */
	static void thread_trampoline(void *p1, void *p2, void *p3);

protected:
	/**
	 * @brief Construct a service.
	 *
	 * @param name Service name.
	 * @param event_queue Event queue associated with the service.
	 * @param subscriptions Events subscribed to by the service.
	 */
	Service(const char *name, k_msgq &event_queue, EventMask subscriptions);

	~Service() = default;

	/**
	 * @brief Called once when the service thread starts.
	 */
	virtual void on_start()
	{
	}

	/**
	 * @brief Handle an event received by the service.
	 *
	 * @param event Event identifier.
	 */
	virtual void on_event(EventId event) = 0;

      private:
	void run();

	const char *m_name;
	k_msgq &m_event_queue;
	EventMask m_subscriptions;
};

} // namespace MyProject

struct service_registration {
	MyProject::Service *service;
};

/**
 * @brief Invoke a callable for each registered service.
 *
 * @tparam Callable Callable type accepting a Service reference.
 * @param callable Callable to invoke for each registered service.
 */
template <typename Callable>
void service_for_each(Callable &&callable)
{
	STRUCT_SECTION_FOREACH(service_registration, registration) {
		callable(*registration->service);
	}
}

template <typename Callable>
void MyProject::Service::for_each(Callable &&callable)
{
	::service_for_each(static_cast<Callable &&>(callable));
}

#define SERVICE_DEFINE(instance_name, service_type, stack_size, priority, queue_depth, ...)        \
	K_MSGQ_DEFINE_STATIC_TYPE(instance_name##_queue, MyProject::EventId, queue_depth);         \
                                                                                                   \
	static service_type instance_name{#instance_name, instance_name##_queue, ##__VA_ARGS__};   \
                                                                                                   \
	K_KERNEL_THREAD_DEFINE(instance_name##_thread, stack_size,                                 \
			       MyProject::Service::thread_trampoline, &instance_name, nullptr,     \
			       nullptr, priority, 0, 0);                                           \
                                                                                                   \
	const STRUCT_SECTION_ITERABLE(service_registration,                                        \
				      instance_name##_registration) = {&instance_name}
```

## include/service_a.hpp
```c
#pragma once

#include "service.hpp"

class ServiceA final: public MyProject::Service
{
public:
	ServiceA(const char *name, k_msgq &event_queue);

protected:
	void on_start() override;
	void on_event(MyProject::EventId event) override;

private:
	static constexpr MyProject::EventMask Subscriptions{};
};
```

## include/service_b.hpp
```c
#pragma once

#include "app_event.hpp"
#include "service.hpp"

class ServiceB final: public MyProject::Service
{
public:
	ServiceB(const char *name, k_msgq &event_queue);

protected:
	void on_start() override;
	void on_event(MyProject::EventId event) override;

private:
	static constexpr auto Subscriptions = MyProject::EventMask::of(Event::ServiceAStarted);
};
```

## src/event_manager.cpp
```c
/*
 * Copyright (c) 2026 Bayrem Gharsellaoui
 * SPDX-License-Identifier: Apache-2.0
 */

#include <zephyr/logging/log.h>
LOG_MODULE_REGISTER(event_manager, LOG_LEVEL_INF);

#include <servz/event_manager.hpp>
#include <servz/service.hpp>

bool servz::EventManager::publish(EventId event)
{
	bool delivered = true;

	Service::for_each([event, &delivered](Service &service) {
		if (!service.subscribes_to(event)) {
			return;
		}

		const int ret = service.post_event(event);

		if (ret != 0) {
			LOG_ERR("Failed to post event to %s: %d", service.get_name(), ret);

			delivered = false;
		}
	});

	return delivered;
}
```

## src/heap_trap.cpp
```c
#include <cstddef>

#include <zephyr/kernel.h>
#include <zephyr/logging/log.h>
LOG_MODULE_REGISTER(heap_trap, LOG_LEVEL_INF);

namespace
{

/**
 * @brief Trap an attempted dynamic memory operation.
 *
 * @param operation Name of the attempted allocation or deallocation operation.
 */
[[noreturn]]
void heap_trap(const char *operation)
{
	LOG_ERR("Dynamic allocation attempted: %s", operation);

	__ASSERT(false, "Dynamic allocation attempted: %s", operation);

	/*
	 * __ASSERT may be compiled out, so this guarantees that
	 * dynamic allocation still fails in non-assert builds.
	 */
	k_panic();

	CODE_UNREACHABLE;
}

} // namespace

extern "C" {

/**
 * @brief Trap use of malloc().
 *
 * @param size Requested allocation size in bytes.
 *
 * @return This function never returns.
 */
void *malloc([[maybe_unused]] std::size_t size)
{
	heap_trap("malloc");
}

/**
 * @brief Trap use of calloc().
 *
 * @param num Number of elements to allocate.
 * @param size Size of each element in bytes.
 *
 * @return This function never returns.
 */
void *calloc([[maybe_unused]] std::size_t num, [[maybe_unused]] std::size_t size)
{
	heap_trap("calloc");
}

/**
 * @brief Trap use of realloc().
 *
 * @param ptr Pointer to the existing allocation.
 * @param size Requested new allocation size in bytes.
 *
 * @return This function never returns.
 */
void *realloc([[maybe_unused]] void *ptr, [[maybe_unused]] std::size_t size)
{
	heap_trap("realloc");
}

/**
 * @brief Trap use of aligned_alloc().
 *
 * @param alignment Requested allocation alignment.
 * @param size Requested allocation size in bytes.
 *
 * @return This function never returns.
 */
void *aligned_alloc([[maybe_unused]] std::size_t alignment, [[maybe_unused]] std::size_t size)
{
	heap_trap("aligned_alloc");
}

/**
 * @brief Trap use of free().
 *
 * @param ptr Pointer to the memory being released.
 */
void free(void *ptr)
{
	if (ptr != nullptr) {
		heap_trap("free");
	}
}

} // extern "C"
```

## src/service.cpp
```c
/*
 * Copyright (c) 2026 Bayrem Gharsellaoui
 * SPDX-License-Identifier: Apache-2.0
 */

#include <servz/service.hpp>

namespace servz
{

Service::Service(const char *name, k_msgq &event_queue, EventMask subscriptions)
	: m_name(name), m_event_queue(event_queue), m_subscriptions(subscriptions)
{
}

const char *Service::get_name() const
{
	return m_name;
}

bool Service::subscribes_to(EventId event) const
{
	return m_subscriptions.contains(event);
}

int Service::post_event(EventId event)
{
	return k_msgq_put(&m_event_queue, &event, K_NO_WAIT);
}

void Service::thread_trampoline(void *p1, void *, void *)
{
	auto *self = static_cast<Service *>(p1);
	self->run();
}

void Service::run()
{
	on_start();

	while (true) {
		EventId event{};

		if (k_msgq_get(&m_event_queue, &event, K_FOREVER) == 0) {
			on_event(event);
		}
	}
}

} // namespace servz
```

## src/service_a.cpp
```c
/*
 * Copyright (c) 2026 Bayrem Gharsellaoui
 * SPDX-License-Identifier: Apache-2.0
 */

#include <zephyr/logging/log.h>
LOG_MODULE_REGISTER(service_a, LOG_LEVEL_INF);

#include "service_a.hpp"
#include "app_event.hpp"
#include "event_manager.hpp"

ServiceA::ServiceA(const char *name, k_msgq &event_queue)
	: Service(name, event_queue, Subscriptions)
{
}

void ServiceA::on_start()
{
	LOG_INF("%s started", get_name());

	LOG_INF("Publishing ServiceAStarted");

	servz::EventManager::publish(static_cast<servz::EventId>(Event::ServiceAStarted));
}

void ServiceA::on_event(servz::EventId event)
{
	ARG_UNUSED(event);
}

SERVICE_DEFINE(service_a, ServiceA, 1024, 5, 8);
```

## src/service_b.cpp
```c
/*
 * Copyright (c) 2026 Bayrem Gharsellaoui
 * SPDX-License-Identifier: Apache-2.0
 */

#include <zephyr/logging/log.h>
LOG_MODULE_REGISTER(service_b, LOG_LEVEL_INF);

#include "service_b.hpp"

ServiceB::ServiceB(const char *name, k_msgq &event_queue)
	: Service(name, event_queue, Subscriptions)
{
}

void ServiceB::on_start()
{
	LOG_INF("%s started", get_name());
}

void ServiceB::on_event(servz::EventId event)
{
	switch (static_cast<Event>(event)) {
	case Event::ServiceAStarted: {
		LOG_INF("Received ServiceAStarted");
		break;
	}

	default: {
		break;
	}
	}
}

SERVICE_DEFINE(service_b, ServiceB, 1024, 5, 8);
```
