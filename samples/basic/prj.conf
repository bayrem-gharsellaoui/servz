## CMakeLists.txt
```
# Copyright (c) 2026 Bayrem Gharsellaoui
# SPDX-License-Identifier: Apache-2.0

cmake_minimum_required(VERSION 3.20.0)
find_package(Zephyr REQUIRED HINTS $ENV{ZEPHYR_BASE})
project(app)

list(APPEND EXTRA_ZEPHYR_MODULES
  ${CMAKE_CURRENT_LIST_DIR}/../..
)

target_include_directories(app PRIVATE
  include
)

target_sources(app PRIVATE
  src/main.cpp
  src/service_a.cpp
  src/service_b.cpp
  src/heap_trap.cpp
)
```

## sample.yaml
```
sample:
  name: servz
  description: Basic servz sample

common:
  tags:
    - servz
    - ipc

tests:
  sample.servz.basic:
    platform_allow:
      - native_sim
    integration_platforms:
      - native_sim
```

## prj.conf
```kconfig
# Copyright (c) 2026 Bayrem Gharsellaoui
# SPDX-License-Identifier: Apache-2.0

# Logging
CONFIG_LOG=y
CONFIG_LOG_INFO_COLOR_GREEN=y
CONFIG_LOG_DBG_COLOR_BLUE=y

# Shell
CONFIG_SHELL=y
CONFIG_KERNEL_SHELL=y
CONFIG_REBOOT=y

# C++
CONFIG_CPP=y
CONFIG_STD_CPP17=y
CONFIG_CPP_EXCEPTIONS=n
CONFIG_CPP_RTTI=n

# No heap
CONFIG_HEAP_MEM_POOL_SIZE=0

# servz
CONFIG_SERVZ=y
CONFIG_SERVZ_LOG_LEVEL_DBG=y

# Debugging
CONFIG_DEBUG=y
CONFIG_DEBUG_THREAD_INFO=y
CONFIG_NO_OPTIMIZATIONS=y
CONFIG_SIZE_OPTIMIZATIONS=n
CONFIG_COMPILER_WARNINGS_AS_ERRORS=y
```

## boards/native_sim.conf
```kconfig
# Copyright (c) 2026 Bayrem Gharsellaoui
# SPDX-License-Identifier: Apache-2.0

# Shell/logging on stdin/stdout
CONFIG_UART_NATIVE_PTY_0_ON_STDINOUT=y
CONFIG_SHELL_LOG_BACKEND=n
CONFIG_LOG_RUNTIME_DEFAULT_LEVEL=4
```

## src/main.cpp
```c
/*
 * Copyright (c) 2026 Bayrem Gharsellaoui
 * SPDX-License-Identifier: Apache-2.0
 */

#include <zephyr/kernel.h>
#include <zephyr/logging/log.h>
LOG_MODULE_REGISTER(app, LOG_LEVEL_INF);

#include <servz/service.hpp>

int main()
{
	LOG_INF("Registered services:");

	servz::Service::for_each(
		[](servz::Service &service) { LOG_INF("- %s", service.get_name()); });

	while (true) {
		k_msleep(1000);
	}

	return 0;
}
```

## include/app_event.hpp
```c
/*
 * Copyright (c) 2026 Bayrem Gharsellaoui
 * SPDX-License-Identifier: Apache-2.0
 */

#pragma once

#include <servz/event.hpp>

enum class Event : servz::EventId {
	ServiceAStarted,

	Count,
};

static_assert(static_cast<servz::EventId>(Event::Count) <= 32);
```

## include/service_a.hpp
```c
/*
 * Copyright (c) 2026 Bayrem Gharsellaoui
 * SPDX-License-Identifier: Apache-2.0
 */

#pragma once

#include <servz/service.hpp>

class ServiceA final: public servz::Service
{
public:
	ServiceA(const char *name, k_msgq &event_queue);

protected:
	void on_start() override;
	void on_event(servz::EventId event) override;

private:
	static constexpr servz::EventMask Subscriptions{};
};
```

## include/service_b.hpp
```c
/*
 * Copyright (c) 2026 Bayrem Gharsellaoui
 * SPDX-License-Identifier: Apache-2.0
 */

#pragma once

#include "app_event.hpp"
#include <servz/service.hpp>

class ServiceB final: public servz::Service
{
public:
	ServiceB(const char *name, k_msgq &event_queue);

protected:
	void on_start() override;
	void on_event(servz::EventId event) override;

private:
	static constexpr auto Subscriptions = servz::EventMask::of(Event::ServiceAStarted);
};
```

## src/service_a.cpp
```c
/*
 * Copyright (c) 2026 Bayrem Gharsellaoui
 * SPDX-License-Identifier: Apache-2.0
 */

#include <zephyr/logging/log.h>
LOG_MODULE_REGISTER(service_a, LOG_LEVEL_INF);

#include <servz/event_manager.hpp>
#include "service_a.hpp"
#include "app_event.hpp"

ServiceA::ServiceA(const char *name, k_msgq &event_queue)
	: Service(name, event_queue, Subscriptions)
{
}

void ServiceA::on_start()
{
	LOG_INF("%s started", get_name());

	LOG_INF("Publishing ServiceAStarted");

	servz::EventManager::publish(static_cast<servz::EventId>(Event::ServiceAStarted));
}

void ServiceA::on_event(servz::EventId event)
{
	ARG_UNUSED(event);
}

SERVZ_SERVICE_DEFINE(service_a, ServiceA, 1024, 5, 8);
```

## src/service_b.cpp
```c
/*
 * Copyright (c) 2026 Bayrem Gharsellaoui
 * SPDX-License-Identifier: Apache-2.0
 */

#include <zephyr/logging/log.h>
LOG_MODULE_REGISTER(service_b, LOG_LEVEL_INF);

#include "service_b.hpp"

ServiceB::ServiceB(const char *name, k_msgq &event_queue)
	: Service(name, event_queue, Subscriptions)
{
}

void ServiceB::on_start()
{
	LOG_INF("%s started", get_name());
}

void ServiceB::on_event(servz::EventId event)
{
	switch (static_cast<Event>(event)) {
	case Event::ServiceAStarted: {
		LOG_INF("Received ServiceAStarted");
		break;
	}

	default: {
		break;
	}
	}
}

SERVZ_SERVICE_DEFINE(service_b, ServiceB, 1024, 5, 8);
```
